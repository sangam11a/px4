## boards/apn/phi-v1/src/custom_uart/Kconfig
```kconfig
menuconfig USER__CUSTOM_UART
	bool "custom uart"
	default n
	---help---
		Enable support for custom uart
```

## boards/apn/phi-v1/src/user/ftdi_comm_modules copy/Kconfig
```kconfig
menuconfig USER__FTDI_COMM_MODULES
	bool "ftdi_communication"
	default n
	---help---
		Enable support for ftdi_communication
```

## boards/apn/phi-v1/src/user/phi_commander/Kconfig
```kconfig
menuconfig USER_HELLO
	bool "HELLO"
	default n
	---help---
		Enable support for HELLO
```

## src/examples/ftdi_comm_modules/Kconfig
```kconfig
menuconfig EXAMPLES_FTDI_COMM_MODULES
	bool "ftdi_communication"
	default n
	---help---
		Enable support for ftdi_communication
```

## src/examples/hello (1)/Kconfig
```kconfig
menuconfig EXAMPLES_HELLO
	bool "HELLO"
	default n
	---help---
		Enable support for PHI
```

## src/examples/mq25t/Kconfig
```kconfig
menuconfig EXAMPLES_MQ25T
	bool "MQ25T"
	default n
	---help---
		Enable support for MQ25T
```

## src/examples/px4_testing/Kconfig
```kconfig
menuconfig EXAMPLES_PX4_TESTING
	bool "px4_testing"
	default n
	---help---
		Enable support for testing
```

## src/examples/uart1/Kconfig
```kconfig
menuconfig EXAMPLES_UART1
	bool "uart1"
	default n
	---help---
		Enable support for uart1
```

## src/modules/flash/Kconfig
```kconfig
menuconfig MODULES_FLASH
	bool "flash"
	default n
	---help---
		Enable support for attached flash device
```
